/* CMSIS-DAP Interface Firmware
 * Copyright (c) 2009-2013 ARM Limited
 *
 * Licensed under the Apache License, Version 2.0 (the "License");
 * you may not use this file except in compliance with the License.
 * You may obtain a copy of the License at
 *
 *     http://www.apache.org/licenses/LICENSE-2.0
 *
 * Unless required by applicable law or agreed to in writing, software
 * distributed under the License is distributed on an "AS IS" BASIS,
 * WITHOUT WARRANTIES OR CONDITIONS OF ANY KIND, either express or implied.
 * See the License for the specific language governing permissions and
 * limitations under the License.
 */

#include "target_flash.h"

const uint32_t K64F_FLM[] = {
    0xE00ABE00, 0x062D780D, 0x24084068, 0xD3000040, 0x1E644058, 0x1C49D1FA, 0x2A001E52, 0x4770D1F2,
    0x4604b570, 0x4616460d, 0x5020f24c, 0x81c84939, 0x1028f64d, 0x460881c8, 0xf0208800, 0x80080001, 
    0x44484835, 0xf8b0f000, 0x2001b108, 0x2000bd70, 0xb530e7fc, 0x4a314603, 0x21032000, 0x4d30e006, 
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    0x01000000, 0x40020004, 0x00000000, 
};

static const TARGET_FLASH flash = {
    0x20000021, // Init
    0x20000053, // UnInit
    0x20000077, // EraseChip
    0x20000099, // EraseSector
    0x200000C5, // ProgramPage
    // breakpoint = RAM start + 1
    // RSB : base address is address of Execution Region PrgData in map file
    //       to access global/static data
    // RSP : Initial stack pointer
    {
        0x20000001, // breakpoint instruction address
        0x20000000 + 0x20 + 0x408,  // static base register value (image start + header + static base offset)
        0x20001000 // initial stack pointer
    },

    0x20001100, // flash_buffer, any valid RAM location with > 512 bytes of working room and proper alignment
    0x20000000, // algo_start, start of RAM
    sizeof(K64F_FLM), // algo_size, size of array above
    K64F_FLM, // image, flash algo instruction array
    512              // ram_to_flash_bytes_to_be_written
};


