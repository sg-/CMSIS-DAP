/* CMSIS-DAP Interface Firmware
 * Copyright (c) 2009-2013 ARM Limited
 *
 * Licensed under the Apache License, Version 2.0 (the "License");
 * you may not use this file except in compliance with the License.
 * You may obtain a copy of the License at
 *
 *     http://www.apache.org/licenses/LICENSE-2.0
 *
 * Unless required by applicable law or agreed to in writing, software
 * distributed under the License is distributed on an "AS IS" BASIS,
 * WITHOUT WARRANTIES OR CONDITIONS OF ANY KIND, either express or implied.
 * See the License for the specific language governing permissions and
 * limitations under the License.
 */

const uint32_t KL25Z_FLM[] = {
    0xE00ABE00, 0x062D780D, 0x24084068, 0xD3000040, 0x1E644058, 0x1C49D1FA, 0x2A001E52, 0x4770D1F2,
    0x4604b570, 0x4616460d, 0x49372000, 0x48376008, 0xf0004448, 0x2800f8b3, 0x2001d001, 0x2000bd70, 
    0xb570e7fc, 0x4a304603, 0x20003aac, 0xe0062103, 0x4e2f008d, 0x6814444e, 0x1d125174, 0x29001e49, 
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    0x00000010, 0x00000020, 0x00000040, 0x00000000, 0x00000000, 0x00000020, 0x40020004, 0x00000000, 
    
};

static const TARGET_FLASH flash = {
    0x20000021, // Init
    0x20000043, // UnInit
    0x20000069, // EraseChip
    0x2000008D, // EraseSector
    0x200000BB, // ProgramPage
    // breakpoint = RAM start + 1
    // RSB : base address is address of Execution Region PrgData in map file
    //       to access global/static data
    // RSP : Initial stack pointer
    {
        0x20000001, // breakpoint instruction address
        0x20000000 + 0x20 + 0x55C,  // static base register value (image start + header + static base offset)
        0x20001000 // initial stack pointer
    },

    0x20001100, // flash_buffer, any valid RAM location with > 512 bytes of working room and proper alignment
    0x20000000, // algo_start, start of RAM
    sizeof(KL25Z_FLM), // algo_size, size of array above
    KL25Z_FLM,  // image, flash algo instruction array
    512         // ram_to_flash_bytes_to_be_written
};




